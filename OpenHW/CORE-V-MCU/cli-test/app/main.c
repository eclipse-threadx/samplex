/***************************************************************************/
/* Copyright (C) 2026 Eclipse ThreadX contributors
 *
 * This program and the accompanying materials are made available under the
 * terms of the MIT License which is available at
 * https://opensource.org/licenses/MIT.
 *
 * AI Disclosure: This file was largely AI-generated by Copilot (Sonnet 4.6).
 * The AI-generated portions may be considered public domain (CC0-1.0)
 * and not subject to the project's licence.
 *
 * SPDX-License-Identifier: MIT and CC0-1.0
 ***************************************************************************/

#include "tx_api.h"
#include "FreeRTOS.h"
#include "system_core_v_mcu.h"
#include "gpio.h"
#include "libs/cli/include/cli.h"
#include "app_commands.h"

#define BLINKY_STACK_SIZE   1024U
#define BLINKY_PRIORITY     10U
#define BLINKY_LED_PIN      4U
#define BLINKY_LED_MASK     (1UL << BLINKY_LED_PIN)
#define BLINKY_PERIOD_TICKS 50U

static TX_THREAD blinky_thread;
static ULONG blinky_stack[BLINKY_STACK_SIZE / sizeof(ULONG)];

/* Blink the LED forever. */
static void blinky_entry(ULONG arg)
{
    ULONG state;

    (void)arg;
    state = 0U;

    for (;;)
    {
        if (state == 0U)
        {
            gpio_clear(BLINKY_LED_MASK);
        }
        else
        {
            gpio_set(BLINKY_LED_MASK);
        }

        state ^= 1U;
        tx_thread_sleep(BLINKY_PERIOD_TICKS);
    }
}

/* Initialize the BSP then enter the ThreadX kernel. */
int main(void)
{
    system_init();
    tx_kernel_enter();
    return 0;
}

/* Create the native ThreadX blinky thread and the CLI FreeRTOS task. */
void tx_application_define(void *first_unused_memory)
{
    UINT status;

    (void)first_unused_memory;

    gpio_set_output(BLINKY_LED_MASK);
    gpio_clear(BLINKY_LED_MASK);

    status = tx_thread_create(&blinky_thread, "blinky", blinky_entry, 0U,
                              blinky_stack, sizeof(blinky_stack),
                              BLINKY_PRIORITY, BLINKY_PRIORITY,
                              TX_NO_TIME_SLICE, TX_AUTO_START);
    if (status != TX_SUCCESS)
    {
        for (;;)
        {
        }
    }

    status = tx_freertos_init();
    if (status != TX_SUCCESS)
    {
        for (;;)
        {
        }
    }

    CLI_start_task(app_get_menu());
}
