/***************************************************************************/
/* Copyright (C) 2026 Eclipse ThreadX contributors
 *
 * This program and the accompanying materials are made available under the
 * terms of the MIT License which is available at
 * https://opensource.org/licenses/MIT.
 *
 * AI Disclosure: This file was largely AI-generated by Copilot (Sonnet 4.6).
 * The AI-generated portions may be considered public domain (CC0-1.0)
 * and not subject to the project's licence.
 *
 * SPDX-License-Identifier: MIT and CC0-1.0
 ***************************************************************************/

#include "app_commands.h"
#include "cli_mock.h"
#include <stdio.h>
#include <string.h>

/* Verify that the version command emits the expected firmware banner. */
static int test_version_output(void)
{
    const struct cli_cmd_entry *menu;
    const char *output;

    cli_mock_reset();
    menu = app_get_menu();
    if ((menu == NULL) || (menu[0].pHandler == NULL))
    {
        return 1;
    }

    menu[0].pHandler(&menu[0]);
    output = cli_mock_get_output();
    if (strstr(output, "CORE-V MCU ThreadX") == NULL)
    {
        return 1;
    }

    return 0;
}

/* Verify that invoking the version handler is safe for a valid menu entry. */
static int test_version_no_crash(void)
{
    const struct cli_cmd_entry *menu;

    cli_mock_reset();
    menu = app_get_menu();
    if ((menu == NULL) || (menu[0].pHandler == NULL))
    {
        return 1;
    }

    menu[0].pHandler(&menu[0]);
    return 0;
}

/* Execute all unit tests and return a process status. */
int main(void)
{
    if (test_version_output() != 0)
    {
        (void)fprintf(stderr, "test_version_output failed\n");
        return 1;
    }

    if (test_version_no_crash() != 0)
    {
        (void)fprintf(stderr, "test_version_no_crash failed\n");
        return 1;
    }

    (void)printf("All CLI tests passed\n");
    return 0;
}
