/***************************************************************************
 * Copyright (C) 2026 Eclipse ThreadX contributors
 *
 * This program and the accompanying materials are made available under the
 * terms of the MIT License which is available at
 * https://opensource.org/licenses/MIT.
 *
 * AI Disclosure: This file was largely AI-generated by Copilot (Sonnet 4.6).
 * The AI-generated portions may be considered public domain (CC0-1.0)
 * and not subject to the project's licence.
 *
 * SPDX-License-Identifier: MIT and CC0-1.0
 ***************************************************************************/

#include "input.h"
#include "uart_driver.h"

key_event_t input_poll(void)
{
    static unsigned int state;
    int c;

    c = uart_read_byte(0U);
    if (c < 0)
    {
        return KEY_NONE;
    }

    if (state == 0U)
    {
        if (c == 0x1BU)
        {
            state = 1U;
            return KEY_NONE;
        }
        return KEY_OTHER;
    }

    if (state == 1U)
    {
        state = 0U;
        if (c == '[')
        {
            state = 2U;
            return KEY_NONE;
        }
        return KEY_OTHER;
    }

    state = 0U;
    switch (c)
    {
        case 'A':
            return KEY_UP;
        case 'B':
            return KEY_DOWN;
        case 'C':
            return KEY_RIGHT;
        case 'D':
            return KEY_LEFT;
        default:
            return KEY_OTHER;
    }
}
