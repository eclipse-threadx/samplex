/***************************************************************************
 * Copyright (C) 2026 Eclipse ThreadX contributors
 *
 * This program and the accompanying materials are made available under the
 * terms of the MIT License which is available at
 * https://opensource.org/licenses/MIT.
 *
 * AI Disclosure: This file was largely AI-generated by Copilot (Sonnet 4.6).
 * The AI-generated portions may be considered public domain (CC0-1.0)
 * and not subject to the project's licence.
 *
 * SPDX-License-Identifier: MIT and CC0-1.0
 ***************************************************************************/

#include <stdint.h>

#include "ansi.h"
#include "progress_bar.h"
#include "uart_io.h"

void progress_bar_render(int row, uint32_t elapsed_ticks, uint32_t total_ticks, int bar_width)
{
    uint32_t inner_width;
    uint32_t pos;
    uint32_t i;

    if (bar_width < 3)
    {
        bar_width = 3;
    }

    inner_width = (uint32_t)(bar_width - 2);
    if ((total_ticks == 0U) || (elapsed_ticks >= total_ticks))
    {
        pos = inner_width;
    }
    else
    {
        pos = (elapsed_ticks * inner_width) / total_ticks;
    }

    ansi_goto(row, 1);
    uio_putc('[');
    for (i = 0U; i < inner_width; ++i)
    {
        if (pos >= inner_width)
        {
            uio_putc('=');
        }
        else if ((elapsed_ticks != 0U) && (i == pos))
        {
            uio_putc('>');
        }
        else if (i < pos)
        {
            uio_putc('=');
        }
        else
        {
            uio_putc(' ');
        }
    }
    uio_putc(']');
    uio_putc(' ');
    uio_put_udec(elapsed_ticks / 100U);
    uio_puts("s      ");
}
