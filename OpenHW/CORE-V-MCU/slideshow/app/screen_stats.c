/***************************************************************************
 * Copyright (C) 2026 Eclipse ThreadX contributors
 *
 * This program and the accompanying materials are made available under the
 * terms of the MIT License which is available at
 * https://opensource.org/licenses/MIT.
 *
 * AI Disclosure: This file was largely AI-generated by Copilot (Sonnet 4.6).
 * The AI-generated portions may be considered public domain (CC0-1.0)
 * and not subject to the project's licence.
 *
 * SPDX-License-Identifier: MIT and CC0-1.0
 ***************************************************************************/

#include <stdint.h>

#include "ansi.h"
#include "tx_api.h"
#include "tx_thread.h"
#include "uart_io.h"

#define _TX_STR(x)  #x
#define TX_STR(x)   _TX_STR(x)
#define TX_VERSION_STRING     "v" TX_STR(THREADX_MAJOR_VERSION)     "." TX_STR(THREADX_MINOR_VERSION)     "." TX_STR(THREADX_PATCH_VERSION)     "." TX_STR(THREADX_BUILD_VERSION)

extern TX_THREAD g_slideshow_thread;

static const char *thread_state_name(UINT state)
{
    switch (state)
    {
        case TX_READY:
            return "READY";
        case TX_COMPLETED:
            return "COMPLETED";
        case TX_TERMINATED:
            return "TERMINATED";
        case TX_SUSPENDED:
            return "SUSPENDED";
        default:
            return "OTHER";
    }
}

void screen_stats_render(void)
{
    TX_THREAD *thread;
    TX_THREAD *start;
    TX_THREAD *current;
    CHAR *name;
    TX_THREAD *next_thread;
    TX_THREAD *next_suspended_thread;
    ULONG tick_count;
    ULONG uptime_seconds;
    ULONG days;
    ULONG hours;
    ULONG minutes;
    ULONG seconds;
    ULONG run_count;
    UINT state;
    UINT priority;
    UINT threshold;
    ULONG time_slice;
    UINT ready_count;
    UINT suspended_count;
    UINT completed_count;
    UINT terminated_count;

    ready_count = 0U;
    suspended_count = 0U;
    completed_count = 0U;
    terminated_count = 0U;

    start = _tx_thread_created_ptr;
    thread = start;
    if (thread != TX_NULL)
    {
        do
        {
            switch (thread->tx_thread_state)
            {
                case TX_READY:
                    ++ready_count;
                    break;
                case TX_SUSPENDED:
                    ++suspended_count;
                    break;
                case TX_COMPLETED:
                    ++completed_count;
                    break;
                case TX_TERMINATED:
                    ++terminated_count;
                    break;
                default:
                    break;
            }
            thread = thread->tx_thread_created_next;
        } while ((thread != TX_NULL) && (thread != start));
    }

    (void)tx_thread_info_get(&g_slideshow_thread, &name, &state, &run_count,
                             &priority, &threshold, &time_slice,
                             &next_thread, &next_suspended_thread);

    tick_count = tx_time_get();
    uptime_seconds = tick_count / 100U;
    days = uptime_seconds / 86400U;
    hours = (uptime_seconds / 3600U) % 24U;
    minutes = (uptime_seconds / 60U) % 60U;
    seconds = uptime_seconds % 60U;
    current = tx_thread_identify();

    ansi_clear_screen();
    ansi_bold();
    ansi_goto(1, 12);
    uio_puts("THREADX SYSTEM STATISTICS");
    ansi_reset_attr();

    ansi_goto(4, 6);
    uio_puts("Uptime: ");
    uio_put_udec((uint32_t)days);
    uio_puts("d ");
    if (hours < 10U) uio_putc('0');
    uio_put_udec((uint32_t)hours);
    uio_putc(':');
    if (minutes < 10U) uio_putc('0');
    uio_put_udec((uint32_t)minutes);
    uio_putc(':');
    if (seconds < 10U) uio_putc('0');
    uio_put_udec((uint32_t)seconds);

    ansi_goto(5, 6);
    uio_puts("Tick count: ");
    uio_put_udec((uint32_t)tick_count);

    ansi_goto(6, 6);
    uio_puts("TX version: ");
    uio_puts(TX_VERSION_STRING);

    ansi_goto(8, 6);
    uio_puts("Created threads   : ");
    uio_put_udec((uint32_t)_tx_thread_created_count);
    ansi_goto(9, 6);
    uio_puts("Running threads   : ");
    uio_put_udec((current != TX_NULL) ? 1U : 0U);
    ansi_goto(10, 6);
    uio_puts("Ready threads     : ");
    uio_put_udec(ready_count);
    ansi_goto(11, 6);
    uio_puts("Suspended threads : ");
    uio_put_udec(suspended_count);
    ansi_goto(12, 6);
    uio_puts("Completed threads : ");
    uio_put_udec(completed_count);
    ansi_goto(13, 6);
    uio_puts("Terminated threads: ");
    uio_put_udec(terminated_count);

    ansi_goto(15, 6);
    uio_puts("Slideshow thread name : ");
    uio_puts((name != TX_NULL) ? name : "(unnamed)");
    ansi_goto(16, 6);
    uio_puts("Slideshow state       : ");
    uio_puts(thread_state_name(state));
    ansi_goto(17, 6);
    uio_puts("Slideshow priority    : ");
    uio_put_udec(priority);
    ansi_goto(18, 6);
    uio_puts("Slideshow run count   : ");
    uio_put_udec((uint32_t)run_count);
}
