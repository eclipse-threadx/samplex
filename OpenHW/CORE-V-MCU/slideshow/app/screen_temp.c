/***************************************************************************
 * Copyright (C) 2026 Eclipse ThreadX contributors
 *
 * This program and the accompanying materials are made available under the
 * terms of the MIT License which is available at
 * https://opensource.org/licenses/MIT.
 *
 * AI Disclosure: This file was largely AI-generated by Copilot (Sonnet 4.6).
 * The AI-generated portions may be considered public domain (CC0-1.0)
 * and not subject to the project's licence.
 *
 * SPDX-License-Identifier: MIT and CC0-1.0
 ***************************************************************************/

#include <stdint.h>

#include "SDKConfig.h"
#include "ansi.h"
#include "big_digits.h"
#include "temp_sensor.h"
#include "uart_io.h"

static void print_temp_value(int32_t value_x10)
{
    uint32_t mag;

    if (value_x10 < 0)
    {
        uio_putc('-');
        mag = 0U - (uint32_t)value_x10;
    }
    else
    {
        mag = (uint32_t)value_x10;
    }

    uio_put_udec(mag / 10U);
    uio_putc('.');
    uio_put_udec(mag % 10U);
    uio_puts("°C");
}

void screen_temp_render(void)
{
    static int initialized;
    static int16_t min_x10;
    static int16_t max_x10;
    static int16_t last_x10;
    int16_t current_x10;
    const char *trend;
    int big_w;
    int big_col;
    int stat_col;

    ansi_clear_screen();
    ansi_bold();
    ansi_center_str(1, "TEMPERATURE");
    ansi_reset_attr();

    {
        int16_t raw_x10 = temp_read_celsius_x10();
        if (raw_x10 == INT16_MIN)
        {
            ansi_center_str(10, "Sensor unavailable");
            return;
        }
        if (raw_x10 == 0)
        {
            ansi_center_str(10, "Sensor warming up...");
            return;
        }
        current_x10 = (int16_t)(raw_x10 + (int16_t)TEMP_CALIBRATION_X10);
    }

    if (initialized == 0)
    {
        initialized = 1;
        min_x10 = current_x10;
        max_x10 = current_x10;
        last_x10 = current_x10;
    }

    if (current_x10 < min_x10)
    {
        min_x10 = current_x10;
    }
    if (current_x10 > max_x10)
    {
        max_x10 = current_x10;
    }

    if (current_x10 > (int16_t)(last_x10 + 2))
    {
        trend = "^ Rising";
    }
    else if (current_x10 < (int16_t)(last_x10 - 2))
    {
        trend = "v Falling";
    }
    else
    {
        trend = "= Stable";
    }

    big_w = big_digits_width_tenths(current_x10);
    big_col = (terminal_cols() - big_w) / 2 + 1;
    if (big_col < 1)
    {
        big_col = 1;
    }
    big_digits_render_tenths(current_x10, 5, big_col);

    /* "\xB0C  Current room temperature" = 28 chars */
    ansi_center_str(11, "°""C  Current room temperature");

    /* "Min: XX.X\xB0C   Max: XX.X\xB0C   Trend: = Stable" ~= 46 chars */
    stat_col = (terminal_cols() - 46) / 2 + 1;
    if (stat_col < 1)
    {
        stat_col = 1;
    }
    ansi_goto(13, stat_col);
    uio_puts("Min: ");
    print_temp_value(min_x10);
    uio_puts("   Max: ");
    print_temp_value(max_x10);
    uio_puts("   Trend: ");
    uio_puts(trend);

    last_x10 = current_x10;
}
