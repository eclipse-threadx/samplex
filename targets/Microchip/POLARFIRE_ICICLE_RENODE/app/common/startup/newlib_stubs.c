/*
 * Copyright (c) 2026 Eclipse ThreadX contributors
 *
 * This program and the accompanying materials are made available
 * under the terms of the MIT license which is available at
 * https://opensource.org/licenses/MIT.
 *
 * SPDX-License-Identifier: MIT
 */

// Some portions generated by Claude Code (Opus 5)

#include <stdint.h>
#include <stddef.h>
#include <errno.h>
#include <malloc.h>
#include <sys/stat.h>
#include "board_config.h"
#include "bsp/console.h"

/* __end, BSP_HEAP_BASE and BSP_HEAP_LIMIT come from board_config.h. */
static char *heap_ptr = NULL;

static inline uintptr_t disable_interrupts(void) {
    uintptr_t mstatus;
    __asm__ volatile("csrrci %0, mstatus, 8" : "=r"(mstatus));
    return mstatus;
}

static inline void restore_interrupts(uintptr_t mstatus) {
    if (mstatus & 8) {
        __asm__ volatile("csrrs zero, mstatus, 8");
    }
}

/* Newlib calls these around every heap operation. The U54 hart running ThreadX
 * is single-core, so masking machine interrupts is sufficient to serialise the
 * malloc arena against both other threads and interrupt handlers. The nesting
 * counter keeps recursive newlib entries from re-enabling interrupts early. */
static uintptr_t s_malloc_lock_mstatus = 0;
static uint32_t  s_malloc_lock_depth = 0;

void __malloc_lock(struct _reent *reent) {
    (void)reent;
    uintptr_t mstatus = disable_interrupts();
    if (s_malloc_lock_depth == 0U) {
        s_malloc_lock_mstatus = mstatus;
    }
    s_malloc_lock_depth++;
}

void __malloc_unlock(struct _reent *reent) {
    (void)reent;
    if (s_malloc_lock_depth == 0U) {
        return;
    }
    s_malloc_lock_depth--;
    if (s_malloc_lock_depth == 0U) {
        restore_interrupts(s_malloc_lock_mstatus);
    }
}

int _write(int file, char *ptr, int len) {
    (void)file;
    if (ptr == NULL || len <= 0)
        return 0;
    bsp_console_write(ptr, (size_t)len);
    return len;
}

void *_sbrk(ptrdiff_t incr) {
    char *prev_heap_ptr;
    uintptr_t mstatus = disable_interrupts();

    if (heap_ptr == NULL) {
        heap_ptr = &__end;
    }

    if (incr > 0) {
        /* Bound against the end of the heap reservation, not the end of DRAM:
         * everything above BSP_HEAP_LIMIT is what bsp_ram_region() hands the
         * application for its ThreadX pool. */
        if ((uintptr_t)heap_ptr + (uintptr_t)incr > BSP_HEAP_LIMIT ||
            (uintptr_t)heap_ptr + (uintptr_t)incr < (uintptr_t)heap_ptr) {
            restore_interrupts(mstatus);
            errno = ENOMEM;
            return (void *)-1;
        }
    } else if (incr < 0) {
        if ((uintptr_t)heap_ptr < (uintptr_t)&__end + (uintptr_t)(-incr)) {
            restore_interrupts(mstatus);
            errno = EINVAL;
            return (void *)-1;
        }
    }

    prev_heap_ptr = heap_ptr;
    heap_ptr += incr;

    restore_interrupts(mstatus);
    return (void *)prev_heap_ptr;
}

int _read(int file, char *ptr, int len) {
  (void)file;
  (void)ptr;
  (void)len;
  return 0;
}

int _close(int file) {
  (void)file;
  return -1;
}

int _fstat(int file, struct stat *st) {
  (void)file;
  st->st_mode = S_IFCHR;
  return 0;
}

int _isatty(int file) {
  (void)file;
  return 1;
}

int _lseek(int file, int ptr, int dir) {
  (void)file;
  (void)ptr;
  (void)dir;
  return 0;
}

void _exit(int status) {
  (void)status;
  while (1) {
    /* Hang on fatal exit */
  }
}
