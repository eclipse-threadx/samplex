/***************************************************************************
 * Copyright (c) 2026 Eclipse ThreadX contributors
 * 
 * This program and the accompanying materials are made available under the
 * terms of the MIT License which is available at
 * https://opensource.org/licenses/MIT.
 * 
 * AI Disclosure: This file was largely AI-generated by Codex (GPT-5).
 * The AI-generated portions may be considered public domain (CC0-1.0)
 * and not subject to the project's licence. The human contributor has
 * reviewed and verified that the code is correct.
 * 
 * SPDX-License-Identifier: MIT and CC0-1.0
 **************************************************************************/

// Some portions generated by Claude Code (Opus 5)

#include "bsp/console.h"
#include "board_config.h"
#include "nucleo_console.h"
#include "stm32f4xx_hal.h"

#include <stddef.h>
#include <stdint.h>

#if BSP_HAS_CONSOLE
static UART_HandleTypeDef console_uart;

static void console_error_handler(void);

/**
 * Halt on an unrecoverable console fault. The console is the only diagnostic
 * channel on this board, so there is nothing left to report a failure through.
 */
static void console_error_handler(void)
{
    while (1)
    {
    }
}
#endif

/*
 * Receive handler registered through bsp_console_set_rx_handler().
 *
 * USART2 is read by polling on this board - nucleo_console_read() blocks in
 * HAL_UART_Receive() - so nothing raises a per-byte receive interrupt and this
 * handler is never invoked. It is stored anyway because the contract in
 * <bsp/console.h> is what lets a portable application register unconditionally
 * without asking which boards have wired an RX interrupt. Wiring USART2_IRQHandler
 * is what would give it a caller.
 */
static bsp_console_rx_fn volatile console_rx_handler = NULL;
static void *volatile console_rx_context = NULL;

void bsp_console_set_rx_handler(bsp_console_rx_fn handler, void *context)
{
    /* Publish the context first: a reader tests the handler to decide whether
     * to dispatch, so a visible handler must already have its context beside
     * it. A single aligned pointer store is atomic on Cortex-M4. */
    console_rx_context = context;
    console_rx_handler = handler;
}

void nucleo_console_rx_dispatch(char c)
{
    bsp_console_rx_fn handler = console_rx_handler;

    if (handler != NULL)
    {
        handler(c, console_rx_context);
    }
}

void bsp_console_init(void)
{
#if BSP_HAS_CONSOLE
    /* GPIO and USART2 clocks are enabled by HAL_UART_MspInit(); enabling them
     * here as well would duplicate the single owner of that configuration. */
    console_uart.Instance          = USART2;
    console_uart.Init.BaudRate     = BSP_UART_BAUDRATE;
    console_uart.Init.WordLength   = UART_WORDLENGTH_8B;
    console_uart.Init.StopBits     = UART_STOPBITS_1;
    console_uart.Init.Parity       = UART_PARITY_NONE;
    console_uart.Init.Mode         = UART_MODE_TX_RX;
    console_uart.Init.HwFlowCtl    = UART_HWCONTROL_NONE;
    console_uart.Init.OverSampling = UART_OVERSAMPLING_16;

    if (HAL_UART_Init(&console_uart) != HAL_OK)
    {
        console_error_handler();
    }
#endif
}

void bsp_console_write(const char *data, size_t length)
{
#if BSP_HAS_CONSOLE
    if ((data == NULL) || (length == 0U))
    {
        return;
    }

    /* MISRA C:2012 Rule 11.8 deviation: HAL_UART_Transmit() takes a non-const
     * uint8_t* even though it only reads the buffer. The cast is confined to
     * this call and the pointed-to data is never modified. */
    (void)HAL_UART_Transmit(&console_uart,
                            (uint8_t *)(uintptr_t)(const void *)data,
                            (uint16_t)length,
                            HAL_MAX_DELAY);
#else
    (void)data;
    (void)length;
#endif
}

void nucleo_console_read(char *data, size_t length)
{
#if BSP_HAS_CONSOLE
    if ((data == NULL) || (length == 0U))
    {
        return;
    }

    (void)HAL_UART_Receive(&console_uart,
                           (uint8_t *)data,
                           (uint16_t)length,
                           HAL_MAX_DELAY);
#else
    (void)data;
    (void)length;
#endif
}
