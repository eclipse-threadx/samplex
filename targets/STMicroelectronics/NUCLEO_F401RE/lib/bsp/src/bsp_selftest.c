/***************************************************************************
 * Copyright (c) 2026 Eclipse ThreadX contributors
 * 
 * This program and the accompanying materials are made available under the
 * terms of the MIT License which is available at
 * https://opensource.org/licenses/MIT.
 * 
 * AI Disclosure: This file was largely AI-generated by Claude Code (Opus 5).
 * The AI-generated portions may be considered public domain (CC0-1.0)
 * and not subject to the project's licence. The human contributor has
 * reviewed and verified that the code is correct.
 * 
 * SPDX-License-Identifier: MIT and CC0-1.0
 **************************************************************************/

/*
 * Startup self-tests for the NUCLEO-F401RE.
 *
 * These check the board support package - the heap bounds its linker script
 * reserves, the clock its init code programs, the timebase its HAL drives - so
 * they live with the board rather than with any application. The application
 * supplies only the reporting callback, which is why this translation unit can
 * include board_config.h and the vendor HAL without dragging either into an
 * application.
 *
 * Every check runs before tx_kernel_enter(), so a failure is reported even
 * when the scheduler never starts.
 */

#include <errno.h>
#include <stddef.h>
#include <stdint.h>
#include <stdio.h>

#include "bsp/memory.h"
#include "bsp/selftest.h"
#include "board_config.h"
#include "stm32f4xx_hal.h"

/*
 * Bounds of the heap reservation and of ThreadX's first free byte.
 * MISRA C:2012 Rule 8.6 deviation: these symbols are defined by
 * NUCLEO_F401RE.ld rather than by any translation unit, which is the only way
 * to import an address decided at link time.
 */
extern char _end;
extern char _heap_limit;
extern char __RAM_segment_used_end__;

/* Defined in newlib_stubs.c, which newlib declares only in private headers. */
extern void *_sbrk(ptrdiff_t incr);

/* Reporting state, kept on the caller's stack so bsp_self_test() holds no
 * mutable state of its own. */
typedef struct {
    bsp_selftest_report_fn report;
    void                  *context;
    unsigned               failures;
} selftest_state;

static void check(selftest_state *state, int passed, const char *message)
{
    if (passed == 0) {
        state->failures++;
    }
    state->report(passed, message, state->context);
}

unsigned bsp_self_test(bsp_selftest_report_fn report, void *context)
{
    selftest_state state;
    char           msg[128];

    const uintptr_t heap_base  = (uintptr_t)&_end;
    const uintptr_t heap_limit = (uintptr_t)&_heap_limit;
    const uintptr_t pool_base  = (uintptr_t)&__RAM_segment_used_end__;

    void   *region_base = NULL;
    size_t  region_size = 0U;
    void   *p_ok;
    void   *p_under;
    void   *p_over;
    uint32_t tick_start;
    uint32_t spins;

    if (report == NULL) {
        return 1U;
    }

    state.report   = report;
    state.context  = context;
    state.failures = 0U;

    /* 1. A modest request lands inside the heap reservation. */
    p_ok = _sbrk(64);
    check(&state, (p_ok != (void *)-1) && ((uintptr_t)p_ok >= heap_base) &&
                      ((uintptr_t)p_ok < heap_limit),
          "_sbrk() valid allocation inside the heap reservation");

    /* 2. Releasing it returns the break to the heap base, leaving the heap
     * exactly as the remaining checks found it. */
    check(&state, _sbrk(-64) != (void *)-1,
          "_sbrk() released 64 bytes back to the heap base");

    /* 3. Shrinking below the heap base is rejected. */
    errno = 0;
    p_under = _sbrk(-128);
    check(&state, (p_under == (void *)-1) && (errno == EINVAL),
          "_sbrk() underflow guard rejected with EINVAL");

    /* 4. Regression guard for the heap bound. 32 KB fits inside the 96 KB SRAM
     * but far exceeds the heap reservation, so bounding _sbrk() against the end
     * of SRAM rather than _heap_limit let this succeed and handed malloc()
     * memory owned by the ThreadX byte pool and the main stack. */
    errno = 0;
    p_over = _sbrk((ptrdiff_t)0x8000);
    check(&state, (p_over == (void *)-1) && (errno == ENOMEM),
          "_sbrk() rejects a request that fits SRAM but not the heap");

    /* 5. The heap reservation must end at or below the first byte ThreadX
     * owns. */
    (void)snprintf(msg, sizeof(msg),
                   "heap [0x%08lX,0x%08lX) ends at or below the ThreadX pool at 0x%08lX",
                   (unsigned long)heap_base, (unsigned long)heap_limit,
                   (unsigned long)pool_base);
    check(&state, heap_limit <= pool_base, msg);

    /* 6. SystemClock_Config() reached the documented 84 MHz. */
    (void)snprintf(msg, sizeof(msg),
                   "SystemCoreClock is %lu Hz (expected %lu Hz)",
                   (unsigned long)SystemCoreClock,
                   (unsigned long)BSP_CPU_CLOCK_HZ);
    check(&state, SystemCoreClock == (uint32_t)BSP_CPU_CLOCK_HZ, msg);

    /* 7. The HAL timebase runs on TIM2 so ThreadX keeps SysTick. HAL_InitTick()
     * is re-entered by HAL_RCC_ClockConfig() once the PLL is live, so confirm
     * the timer is still ticking afterwards. The spin cap is a liveness bound,
     * not a timing expectation: one TIM2 tick is ~84000 core cycles. */
    tick_start = HAL_GetTick();
    spins = 0;
    while ((HAL_GetTick() == tick_start) && (spins < 5000000UL)) {
        spins++;
    }
    check(&state, HAL_GetTick() != tick_start,
          "HAL timebase (TIM2) tick advancing");

    /* 8. The region bsp_ram_region() hands the application must start above
     * the heap reservation and end inside SRAM. This is the invariant that
     * keeps malloc() and the ThreadX byte pool from ever overlapping. */
    bsp_ram_region(&__RAM_segment_used_end__, &region_base, &region_size);
    (void)snprintf(msg, sizeof(msg),
                   "bsp_ram_region() yields [0x%08lX,0x%08lX), clear of the heap and inside SRAM",
                   (unsigned long)(uintptr_t)region_base,
                   (unsigned long)((uintptr_t)region_base + region_size));
    check(&state,
          (region_size > 0U) && ((uintptr_t)region_base >= heap_limit) &&
              (((uintptr_t)region_base + region_size) <= (uintptr_t)BSP_RAM_END),
          msg);

    return state.failures;
}
