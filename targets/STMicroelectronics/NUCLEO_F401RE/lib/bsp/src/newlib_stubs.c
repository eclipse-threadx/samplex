/***************************************************************************
 * Copyright (c) 2026 Eclipse ThreadX contributors
 * 
 * This program and the accompanying materials are made available under the
 * terms of the MIT License which is available at
 * https://opensource.org/licenses/MIT.
 * 
 * AI Disclosure: This file was largely AI-generated by Codex (GPT-5).
 * The AI-generated portions may be considered public domain (CC0-1.0)
 * and not subject to the project's licence. The human contributor has
 * reviewed and verified that the code is correct.
 * 
 * SPDX-License-Identifier: MIT and CC0-1.0
 **************************************************************************/

/*
 * Newlib retargeting for the NUCLEO-F401RE.
 *
 * Every newlib syscall override lives in this translation unit, which is
 * compiled directly into the application (see ../../../app/CMakeLists.txt)
 * rather than archived into libnucleo_bsp.a. A static archive member is only
 * extracted when an undefined symbol already demands it, and newlib's own
 * references are resolved after the BSP archive has been scanned; keeping the
 * overrides in an always-linked object guarantees they win over the
 * libnosys stubs instead of depending on archive ordering.
 */

#include <errno.h>
#include <stddef.h>
#include <stdint.h>
#include <sys/stat.h>

#include "bsp/console.h"
#include "nucleo_console.h"
#include "stm32f4xx.h"

/*
 * Linker-defined bounds of the heap reservation in NUCLEO_F401RE.ld.
 * MISRA C:2012 Rule 8.6 deviation: these symbols are defined by the linker
 * script, not by any translation unit, which is the only way to import an
 * address decided at link time.
 */
extern char _end;
extern char _heap_limit;

/*
 * newlib declares these in its internal headers only. Declaring them here
 * keeps every definition preceded by a prototype (MISRA C:2012 Rule 8.4).
 */
void *_sbrk(ptrdiff_t incr);
int _close(int file);
int _fstat(int file, struct stat *st);
int _isatty(int file);
int _lseek(int file, int ptr, int dir);
void _exit(int status);
int _kill(int pid, int sig);
int _getpid(void);
int _read(int file, char *ptr, int len);
int _write(int file, char *ptr, int len);
int __io_putchar(int ch);
int __io_getchar(void);

void *_sbrk(ptrdiff_t incr)
{
    static uint8_t *heap_ptr = NULL;

    const uintptr_t heap_base  = (uintptr_t)&_end;
    const uintptr_t heap_limit = (uintptr_t)&_heap_limit;

    uintptr_t current;
    uintptr_t next;
    uint32_t primask;

    /* Mask interrupts to ensure thread-safe heap pointer mutation on Cortex-M4.
     * This protects the break pointer only; newlib's malloc free lists remain
     * unguarded, so concurrent malloc() from multiple threads still requires
     * newlib's own lock hooks. */
    primask = __get_PRIMASK();
    __disable_irq();

    if (heap_ptr == NULL) {
        heap_ptr = (uint8_t *)heap_base;
    }
    current = (uintptr_t)heap_ptr;

    if (incr < 0) {
        /* Negate without overflowing on PTRDIFF_MIN. */
        uintptr_t decrement = (uintptr_t)(-(incr + 1)) + 1U;

        if (decrement > (current - heap_base)) {
            __set_PRIMASK(primask);
            errno = EINVAL;
            return (void *)-1;
        }
        next = current - decrement;
    } else {
        uintptr_t increment = (uintptr_t)incr;

        /* Bound against the end of the heap reservation, not the end of SRAM:
         * beyond _heap_limit lie the reserved main stack and the ThreadX byte
         * pool holding every thread stack. */
        if (increment > (heap_limit - current)) {
            __set_PRIMASK(primask);
            errno = ENOMEM;
            return (void *)-1;
        }
        next = current + increment;
    }

    heap_ptr = (uint8_t *)next;

    __set_PRIMASK(primask);
    return (void *)current;
}

int _close(int file)
{
    (void)file;
    return -1;
}

int _fstat(int file, struct stat *st)
{
    (void)file;
    st->st_mode = S_IFCHR;
    return 0;
}

int _isatty(int file)
{
    (void)file;
    return 1;
}

int _lseek(int file, int ptr, int dir)
{
    (void)file;
    (void)ptr;
    (void)dir;
    return 0;
}

void _exit(int status)
{
    (void)status;
    __disable_irq();
    while (1) {
        __WFI();
    }
}

int _kill(int pid, int sig)
{
    (void)pid;
    (void)sig;
    errno = EINVAL;
    return -1;
}

int _getpid(void)
{
    return 1;
}

int __io_putchar(int ch)
{
    char c = (char)ch;

    bsp_console_write(&c, 1U);
    return ch;
}

int __io_getchar(void)
{
    char ch = '\0';

    nucleo_console_read(&ch, 1U);
    return (int)(unsigned char)ch;
}

int _read(int file, char *ptr, int len)
{
    (void)file;

    if ((ptr == NULL) || (len <= 0)) {
        return 0;
    }
    nucleo_console_read(ptr, (size_t)len);
    return len;
}

int _write(int file, char *ptr, int len)
{
    (void)file;

    if ((ptr == NULL) || (len <= 0)) {
        return 0;
    }
    bsp_console_write(ptr, (size_t)len);
    return len;
}
